## boards/shields/komfee/Kconfig.defconfig
```kconfig
if SHIELD_KOMFEE_LEFT

config ZMK_KEYBOARD_NAME
    default "Komfee"

config ZMK_SPLIT_ROLE_CENTRAL
    default y

endif

if SHIELD_KOMFEE_LEFT || SHIELD_KOMFEE_RIGHT

config ZMK_SPLIT
    default y

endif
```

## boards/shields/komfee/Kconfig.shield
```kconfig
config SHIELD_KOMFEE_LEFT
    def_bool $(shields_list_contains,komfee_left)

config SHIELD_KOMFEE_RIGHT
    def_bool $(shields_list_contains,komfee_right)
```
